## config/west.yml
```yaml
manifest:
  remotes:
    - name: zmkfirmware
      url-base: https://github.com/zmkfirmware
    - name: m165437 #change display
      url-base: https://github.com/M165437 #change display
  projects:
    - name: zmk
      remote: zmkfirmware
      revision: main
      import: app/west.yml
    - name: nice-view-gem #change display
      remote: m165437 #change display
      revision: main #change display
  self:
    path: config
```
